## base_external/Config.in
```kconfig
source "$BR2_EXTERNAL_buildroot_assignment_PATH/package/aesd-assignments/Config.in"
source "$BR2_EXTERNAL_buildroot_assignment_PATH/package/ldd/Config.in"
```

## base_external/package/ldd/Config.in
```kconfig
config BR2_PACKAGE_LDD
	bool "ldd"
        depends on BR2_LINUX_KERNEL
	help
	  Includes the misc and scull module into image.
	  Used to understand buildroot external trees and package builds.
```
